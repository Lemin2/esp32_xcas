## main/Kconfig.projbuild
```kconfig
menu "XCAS Configuration"

    choice XCAS_BOARD
        prompt "Target development board"
        default XCAS_BOARD_CARDPUTER if IDF_TARGET_ESP32S3
        default XCAS_BOARD_TAB5 if IDF_TARGET_ESP32P4
        help
            Select the board support package used by the GUI front-end.

        config XCAS_BOARD_CARDPUTER
            bool "M5Stack Cardputer"
            depends on IDF_TARGET_ESP32S3
            help
                Use the in-tree Cardputer display and physical keyboard BSP.

        config XCAS_BOARD_TAB5
            bool "M5Stack Tab5"
            depends on IDF_TARGET_ESP32P4
            help
                Use the ESP Component Registry M5Stack Tab5 BSP. Tab5 is a touch-only
                ESP32-P4 board with a high-resolution 5 inch display.
    endchoice

    config XCAS_USE_SCREEN_KEYBOARD
        bool "Enable on-screen keyboard"
        default y if XCAS_BOARD_TAB5
        default n if XCAS_BOARD_CARDPUTER
        help
            Enables an LVGL on-screen keyboard with normal and math layouts.

    config XCAS_HAS_PHYSICAL_KEYBOARD
        bool "Enable physical keyboard input"
        default y if XCAS_BOARD_CARDPUTER
        default n if XCAS_BOARD_TAB5
        help
            Enables board physical keyboard scanning and mapped-key dispatch.

    config XCAS_ENABLE_USB_HID_INPUT
        bool "Enable USB HID keyboard input"
        default n
        depends on XCAS_BOARD_TAB5
        help
            Enables USB HID input support on boards with USB host capability.

    config XCAS_ENABLE_WIFI
        bool "Enable WiFi support in GUI settings"
        default n
        help
            Builds the ESP WiFi stack and enables WiFi controls in the Settings app.
            Keep disabled on the default 8MB/no-PSRAM image to save flash and RAM.

    config XCAS_ENABLE_BLUETOOTH
        bool "Enable Bluetooth support in GUI settings"
        default n
        help
            Builds the ESP Bluetooth stack and enables Bluetooth controls in the Settings app.
            Keep disabled by default to save flash and RAM.

    config CONSOLE_STORE_HISTORY
        bool "Store command history in flash"
        default y
        help
            Linenoise line editing library provides functions to save and load
            command history. If this option is enabled, initializes a FAT filesystem
            and uses it to store command history.

    config CONSOLE_IGNORE_EMPTY_LINES
        bool "Ignore empty lines inserted into the console"
        default y
        help
            If an empty line is inserted to the console, the Console can either
            ignore empty lines (the example would continue), or break on empty lines
            (the example would stop after an empty line).

endmenu
```

## sdkconfig.defaults
```kconfig
# Reduce bootloader log verbosity
CONFIG_BOOTLOADER_LOG_LEVEL_WARN=y
CONFIG_BOOTLOADER_LOG_LEVEL=2

# Increase main task stack size
CONFIG_ESP_MAIN_TASK_STACK_SIZE=7168

# Enable filesystem
CONFIG_PARTITION_TABLE_CUSTOM=y
CONFIG_PARTITION_TABLE_CUSTOM_FILENAME="partitions_example.csv"
CONFIG_PARTITION_TABLE_FILENAME="partitions_example.csv"

# Enable FreeRTOS stats formatting functions, needed for 'tasks' command
CONFIG_FREERTOS_USE_TRACE_FACILITY=y
CONFIG_FREERTOS_USE_STATS_FORMATTING_FUNCTIONS=y

# On chips with USB serial, disable secondary console which does not make sense when using console component
CONFIG_ESP_CONSOLE_SECONDARY_NONE=y

# Optimize for size: giac is large, keep total instruction code within the flash mapping window
CONFIG_COMPILER_OPTIMIZATION_SIZE=y

# Tab5 boards in use report 16MB flash and ESP32-P4 rev v1.x.
CONFIG_ESP32P4_SELECTS_REV_LESS_V3=y
CONFIG_ESP32P4_REV_MIN_100=y
CONFIG_ESP32P4_REV_MIN_FULL=100
CONFIG_ESP_REV_MIN_FULL=100
CONFIG_ESPTOOLPY_FLASHFREQ_40M=y
CONFIG_ESPTOOLPY_FLASHFREQ_VAL=40
CONFIG_ESPTOOLPY_FLASHFREQ="40m"
CONFIG_ESPTOOLPY_FLASHSIZE_16MB=y
CONFIG_ESPTOOLPY_FLASHSIZE="16MB"
CONFIG_ESP_DEFAULT_CPU_FREQ_MHZ_360=y
CONFIG_ESP_DEFAULT_CPU_FREQ_MHZ=360

# LVGL observer/data-binding is enabled by component defaults. Turn on object
# property interface explicitly so UI can use property-based updates.
CONFIG_LV_USE_OBJ_PROPERTY=y

# Use the ESP-IDF/libc heap for LVGL allocations instead of LVGL's fixed
# builtin TLSF pool, so UI objects are backed by the system heap/PSRAM policy.
CONFIG_LV_USE_CLIB_MALLOC=y
CONFIG_LV_USE_FLOAT=y
CONFIG_LV_USE_GESTURE_RECOGNITION=y

# Use Source Han Sans SC as the default built-in LVGL font set.
CONFIG_LV_FONT_MONTSERRAT_22=y
CONFIG_LV_FONT_SOURCE_HAN_SANS_SC_14_CJK=y
CONFIG_LV_FONT_SOURCE_HAN_SANS_SC_16_CJK=y
CONFIG_LV_FONT_DEFAULT_SOURCE_HAN_SANS_SC_14_CJK=y

# Auto-detect PSRAM when present, but keep booting on boards without it.
CONFIG_SPIRAM=y
CONFIG_SPIRAM_SPEED_80M=y
CONFIG_SPIRAM_BOOT_HW_INIT=y
CONFIG_SPIRAM_BOOT_INIT=y
CONFIG_SPIRAM_IGNORE_NOTFOUND=y
CONFIG_SPIRAM_USE_MALLOC=y
CONFIG_SPIRAM_MALLOC_ALWAYSINTERNAL=16384
CONFIG_SPIRAM_MALLOC_RESERVE_INTERNAL=32768

# Keep Tab5 MIPI-DSI/LVGL load conservative on P4 rev v1.x.
CONFIG_BSP_LCD_DRAW_BUF_HEIGHT=20
# CONFIG_BSP_LCD_DRAW_BUF_DOUBLE is not set
CONFIG_BSP_LCD_DPI_BUFFER_NUMS=1
```

## sdkconfig.defaults.esp32p4
```kconfig
# Tab5 display path follows the M5Stack UserDemo memory/cache profile closely.
# The MIPI-DSI panel fetches from external RAM; slower PSRAM/cache settings can
# trigger LCD underruns under LVGL load.
CONFIG_SPIRAM_SPEED_200M=y
CONFIG_SPIRAM_SPEED=200
CONFIG_SPIRAM_XIP_FROM_PSRAM=y
CONFIG_SPIRAM_FETCH_INSTRUCTIONS=y
CONFIG_SPIRAM_RODATA=y
CONFIG_SPIRAM_FLASH_LOAD_TO_PSRAM=y
CONFIG_CACHE_L2_CACHE_256KB=y
CONFIG_CACHE_L2_CACHE_SIZE=0x40000
CONFIG_CACHE_L2_CACHE_LINE_128B=y
CONFIG_CACHE_L2_CACHE_LINE_SIZE=128
CONFIG_FREERTOS_HZ=1000
CONFIG_PARTITION_TABLE_CUSTOM_FILENAME="partitions_tab5.csv"
CONFIG_PARTITION_TABLE_FILENAME="partitions_tab5.csv"
CONFIG_LV_USE_TINY_TTF=y
CONFIG_LV_TINY_TTF_FILE_SUPPORT=y
CONFIG_LV_TINY_TTF_CACHE_GLYPH_CNT=96
CONFIG_LV_USE_FS_STDIO=y
CONFIG_LV_FS_STDIO_LETTER=65
CONFIG_LV_FS_STDIO_PATH=""

# Tab5 automation uses the board USB COM port. Bind stdin/stdout to USB-SERIAL-JTAG
# instead of GPIO UART0 so ESP-IDF monitor and ML debug commands can write back.
CONFIG_ESP_CONSOLE_USB_SERIAL_JTAG=y
CONFIG_ESP_CONSOLE_SECONDARY_NONE=y
```

## sdkconfig.defaults.esp32s3
```kconfig
# Cardputer S3 defaults.
CONFIG_PARTITION_TABLE_CUSTOM=y
CONFIG_PARTITION_TABLE_CUSTOM_FILENAME="partitions_example.csv"
CONFIG_PARTITION_TABLE_FILENAME="partitions_example.csv"

CONFIG_ESPTOOLPY_FLASHFREQ_80M=y
CONFIG_ESPTOOLPY_FLASHFREQ="80m"
CONFIG_ESPTOOLPY_FLASHSIZE_8MB=y
CONFIG_ESPTOOLPY_FLASHSIZE="8MB"
CONFIG_ESP_DEFAULT_CPU_FREQ_MHZ_240=y
CONFIG_ESP_DEFAULT_CPU_FREQ_MHZ=240

# S3 board PSRAM policy.
CONFIG_SPIRAM=y
CONFIG_SPIRAM_MODE_QUAD=y
CONFIG_SPIRAM_TYPE_AUTO=y
CONFIG_SPIRAM_CLK_IO=30
CONFIG_SPIRAM_CS_IO=26
CONFIG_SPIRAM_SPEED_80M=y
CONFIG_SPIRAM_SPEED=80
CONFIG_SPIRAM_BOOT_HW_INIT=y
CONFIG_SPIRAM_BOOT_INIT=y
CONFIG_SPIRAM_PRE_CONFIGURE_MEMORY_PROTECTION=y
CONFIG_SPIRAM_IGNORE_NOTFOUND=y
CONFIG_SPIRAM_USE_MALLOC=y
CONFIG_SPIRAM_MEMTEST=y
CONFIG_SPIRAM_MALLOC_ALWAYSINTERNAL=16384
CONFIG_SPIRAM_MALLOC_RESERVE_INTERNAL=32768
```
